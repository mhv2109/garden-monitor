## components/batt/Kconfig.projbuild
```kconfig
menu "Garden Monitor Battery Monitor Configuration"

    choice BATT_ADC_CHANNEL
        prompt "Analog pin for monitoring battery"
        default BATT_ADC1_CHANNEL_6
        help
            Battery voltage is monitored using a voltage splitter circuit & analog measurement pin
        
        config BATT_ADC1_CHANNEL_6
            bool "A2"
    endchoice

    config BATT_ADC_DEFAULT_VREF
        int "Default VRef (mV)"
        default 1100
        help
            Find default vref by running `$ espefuse.py --port /dev/ttyUSB0 adc_info`

endmenu
```

## components/gm_mqtt/Kconfig.projbuild
```kconfig
menu "Garden Monitor MQTT Configuration"

config MQTT_BROKER_URI
       string "MQTT Broker URI"
       default "mqtt://username:password@mqtt.eclipse.org:1883"
       help
        Full URI to MQTT Broker including IP address, port, and username & password (if necessary)

config MQTT_TEMPERATURE_TOPIC
       string "Temperature topic"
       default "garden/monitor/temperature"
       help
        MQTT topic for temperature readings

config MQTT_HUMIDITY_TOPIC
       string "Humidity topic"
       default "garden/monitor/humidity"
       help
        MQTT topic for humidity readings

config MQTT_LUX_TOPIC
       string "Lux topic"
       default "garden/monitor/lux"
       help
        MQTT topic for lux light intesnsity (lux) readings

config MQTT_SOIL_MOISTURE_TOPIC
       string "Soil moisture topic"
       default "garden/monitor/soil_moisture"
       help
        MQTT topic for soil moisture readings

config MQTT_BATTERY_VOLTAGE_TOPIC
        string "Battery voltage topic"
        default "garden/monitor/battery/voltage"
        help
         MQTT topic for battery voltage readings

endmenu
```

## components/i2c/Kconfig.projbuild
```kconfig
menu "Garden Monitor I2C Configuration"

    choice SDA_PIN
        prompt "SDA pin for I2C bus"
        default SDA_NUM_23
        help
            SDA pin for I2C bus, data line for bus used to communicate with peripherals

        config SDA_NUM_2
            bool "GPIO 2"
        config SDA_NUM_15
            bool "GPIO 15"
        config SDA_NUM_21
            bool "GPIO 21"
        config SDA_NUM_22
            bool "GPIO 22"
        config SDA_NUM_23
            bool "GPIO 23"
    endchoice

    choice SCL_PIN
        prompt "SCL pin for I2C bus"
        default SCL_NUM_22
        help
            SCL pin for I2C bus, clock line for bus used to communicate with peripherals
        
        config SCL_NUM_2
            bool "GPIO 2"
        config SCL_NUM_15
            bool "GPIO 15"
        config SCL_NUM_21
            bool "GPIO 21"
        config SCL_NUM_22
            bool "GPIO 22"
        config SCL_NUM_23
            bool "GPIO 23"
    endchoice
endmenu
```

## components/wifi/Kconfig.projbuild
```kconfig
menu "Garden Monitor WiFi Configuration"

config WIFI_SSID
       string "WiFi SSID"
       default "myssid"
       help
        WiFi SSID to connect to

config WIFI_PASS
       string "WiFi Password"
       default "mypassword"
       help
        WiFi password to use

endmenu
```

## main/Kconfig.projbuild
```kconfig
menu "Garden Monitor Power Management Configuration"
     
    choice MAX_CPU_FREQ
        prompt "Maximum CPU frequency"
        default MAX_CPU_FREQ_80
        depends on PM_ENABLE
        help
          Maximum CPU frequency to use for dynamic frequency scaling.

        config MAX_CPU_FREQ_80
            bool "80 MHz"
        config MAX_CPU_FREQ_160
            bool "160 MHz"
        config MAX_CPU_FREQ_240
            bool "240 MHz"
            depends on IDF_TARGET_ESP32 || IDF_TARGET_ESP32S2 || IDF_TARGET_ESP32S3
    endchoice

    config MAX_CPU_FREQ_MHZ
        int
        default 80 if MAX_CPU_FREQ_80
        default 160 if MAX_CPU_FREQ_160
        default 240 if MAX_CPU_FREQ_240

    choice MIN_CPU_FREQ
        prompt "Minimum CPU frequency"
        default MIN_CPU_FREQ_10M
        depends on PM_ENABLE
        help
          Minimum CPU frequency to use for dynamic frequency scaling.
          Should be set to XTAL frequency or XTAL frequency divided by integer.

        config MIN_CPU_FREQ_40M
            bool "40 MHz (use with 40MHz XTAL)"
            depends on IDF_TARGET_ESP32S2 || IDF_TARGET_ESP32C3 || ESP32_XTAL_FREQ_40 || ESP32_XTAL_FREQ_AUTO
        config MIN_CPU_FREQ_20M
            bool "20 MHz (use with 40MHz XTAL)"
            depends on IDF_TARGET_ESP32S2 || IDF_TARGET_ESP32C3 || ESP32_XTAL_FREQ_40 || ESP32_XTAL_FREQ_AUTO
        config MIN_CPU_FREQ_10M
            bool "10 MHz (use with 40MHz XTAL)"
            depends on IDF_TARGET_ESP32S2 || IDF_TARGET_ESP32C3 || ESP32_XTAL_FREQ_40 || ESP32_XTAL_FREQ_AUTO
        config MIN_CPU_FREQ_26M
            bool "26 MHz (use with 26MHz XTAL)"
            depends on ESP32_XTAL_FREQ_26 || ESP32_XTAL_FREQ_AUTO
        config MIN_CPU_FREQ_13M
            bool "13 MHz (use with 26MHz XTAL)"
            depends on ESP32_XTAL_FREQ_26 || ESP32_XTAL_FREQ_AUTO
    endchoice

    config MIN_CPU_FREQ_MHZ
        int
        default 40 if MIN_CPU_FREQ_40M
        default 20 if MIN_CPU_FREQ_20M
        default 10 if MIN_CPU_FREQ_10M
        default 26 if MIN_CPU_FREQ_26M
        default 13 if MIN_CPU_FREQ_13M

endmenu
```
